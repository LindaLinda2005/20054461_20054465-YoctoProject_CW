## 20054461_20054465_EOS-CW-Submission/YoctoFiles/meta-custom-image-mods/conf/layer.conf
```bitbake
# Layer configuration for meta-custom-image-mods
# We have a conf and classes directory, add to BBPATH
BBPATH .= ":${LAYERDIR}"

# We have recipes-* directories, add to BBFILES
BBFILES += "${LAYERDIR}/recipes-*/*/*.bb \
	${LAYERDIR}/recipes-*/*/*.bbappend"

BBFILE_COLLECTIONS += "custom-image-mods"
BBFILE_PATTERN_custom-image-mods = "^${LAYERDIR}/"
BBFILE_PRIORITY_custom-image-mods = "1"
LAYERVERSION_custom-image-mods = "1"
LAYERSERIES_COMPAT_custom-image-mods = "scarthgap"
```
